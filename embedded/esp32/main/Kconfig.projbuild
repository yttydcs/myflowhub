## embedded/esp32/main/Kconfig.projbuild
```kconfig
menu "MyFlowHub ESP32 demo"

config MFH_WIFI_SSID
    string "Wi-Fi SSID"
    default ""

config MFH_WIFI_PASSWORD
    string "Wi-Fi password"
    default ""

config MFH_PARENT_HOST
    string "Parent Hub host"
    default "192.168.1.2"

config MFH_PARENT_PORT
    int "Parent Hub TCP port"
    range 1 65535
    default 7443

config MFH_NODE_ID
    int "Device node ID"
    range 1 2147483647
    default 2

config MFH_PARENT_NODE_ID
    int "Parent node ID"
    range 1 2147483647
    default 1

config MFH_PARENT_PUBLIC_KEY
    string "Parent Ed25519 public key (base64)"
    default ""

config MFH_PERMIT_JSON
    string "Optional provisioning permit JSON"
    default ""

config MFH_CONFIG_REVISION
    int "Persistent configuration revision"
    range 1 2147483647
    default 1

config MFH_RESET_STATE_ON_BOOT
    bool "Explicitly erase MyFlowHub identity/config on boot"
    default n

endmenu
```
